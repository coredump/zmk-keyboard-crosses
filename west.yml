## west.yml
```yaml
manifest:
  remotes:
    - name: badjeff
      url-base: https://github.com/badjeff
    - name: efogdev
      url-base: https://github.com/efogdev
  projects:
    - name: zmk-pmw3610-driver
      remote: efogdev
      revision: main
      path: modules/zmk/pmw3610-driver
    - name: zmk-input-processor-report-rate-limit
      remote: badjeff
      revision: main
      path: modules/zmk/input-processor-report-rate-limit
```
